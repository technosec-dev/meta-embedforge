## conf/distro/embedforge.conf
```bitbake
# EmbedForge Distribution Configuration
#
# Minimal systemd-based distribution for embedded Linux builds.
# Does NOT inherit from defaultsetup.conf — BitBake loads it automatically.
# Does NOT set PREFERRED_PROVIDER_virtual/kernel — BSP machine conf decides.
#
# Templates can override any of these settings via local.conf.
# Orgs with custom distros can use their own distro layer instead.

DISTRO = "embedforge"
DISTRO_NAME = "EmbedForge"
DISTRO_VERSION = "1.0"

# Minimal feature set — templates add what they need
DISTRO_FEATURES = "acl ipv4 ipv6 largefile seccomp systemd usrmerge xattr"

# systemd as init manager (no sysvinit)
VIRTUAL-RUNTIME_init_manager = "systemd"
VIRTUAL-RUNTIME_initscripts = "systemd-compat-units"
VIRTUAL-RUNTIME_login_manager = "shadow-base"
DISTRO_FEATURES_BACKFILL_CONSIDERED += "sysvinit"

# Build-time packaging only — no package manager in final image
PACKAGE_CLASSES = "package_rpm"

# Reproducible builds
BUILD_REPRODUCIBLE_BINARIES = "1"

# Security hardening
SECURITY_CFLAGS ?= "-fstack-protector-strong -D_FORTIFY_SOURCE=2"

# No GUI by default — embedded systems are headless unless template says otherwise
# Templates that need graphics add: DISTRO_FEATURES:append = " opengl wayland"

# Fetcher resilience. crates.io (Fastly CDN) rate-limits build-server IPs,
# and some upstream mirrors are intermittently slow. Bump wget retries from
# the default 2 to 5 with a shorter per-attempt timeout so builds survive
# transient CDN errors without waiting 200+ seconds per retry.
FETCHCMD_wget = "/usr/bin/env wget -t 5 -T 60 --passive-ftp"
```

## conf/layer.conf
```bitbake
# Layer configuration for meta-embedforge
# EmbedForge distribution layer — minimal systemd-based defaults for embedded Linux builds

# Add layer root to BBPATH so BitBake finds conf/distro/embedforge.conf
BBPATH .= ":${LAYERDIR}"

# We have recipes-* directories, add to BBFILES
BBFILES += "${LAYERDIR}/recipes-*/*/*.bb \
            ${LAYERDIR}/recipes-*/*/*.bbappend"

BBFILE_COLLECTIONS += "embedforge"
BBFILE_PATTERN_embedforge = "^${LAYERDIR}/"
BBFILE_PRIORITY_embedforge = "6"

# Only depends on openembedded-core (meta layer)
LAYERDEPENDS_embedforge = "core"

# Compatible with all Yocto releases EmbedForge supports, including legacy.
# Customers with existing firmwares built on older Yocto versions can use
# EmbedForge for long-term maintenance, security patching, and migration.
LAYERSERIES_COMPAT_embedforge = "dunfell gatesgarth hardknott honister kirkstone langdale mickledore nanbield scarthgap styhead walnascar whinlatter wrynose"
```
